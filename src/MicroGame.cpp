/*MicroGame library by Jason A. Naquin.
Adafruit_SSD1306 library written by Limor Fried/Ladyada for Adafruit Industries*/

#include "Arduino.h"
#include "MicroGame.h"
#include "Adafruit_SSD1306.h"

String versionNum = "v1.2.1";

MicroGame::MicroGame(){}

Adafruit_SSD1306 MicroGame::display = Adafruit_SSD1306(128, 64, &Wire);

unsigned char PROGMEM MicroGame::splashScreen[] = {
    0x00, 0x00, 0x00, 0x00, 0x00, 0x00, 0x00, 0x00, 0x00, 0x00, 0x00, 0x00, 0x00, 0x00, 0x00, 0x00, 0x00, 0x00, 0x00, 0x00, 0x00, 0x00, 0x00, 0x00, 0x00, 0x00, 0x00, 0x00, 0x00, 0x00, 0x00, 0x00, 
    0x00, 0x00, 0x00, 0x00, 0x00, 0x00, 0x00, 0x00, 0x00, 0x00, 0x00, 0x00, 0x00, 0x00, 0x00, 0x00, 0x00, 0x00, 0x00, 0x00, 0x00, 0x00, 0x00, 0x00, 0x00, 0x00, 0x00, 0x00, 0x00, 0x00, 0x00, 0x00, 
    0x00, 0x00, 0x00, 0x00, 0x00, 0x00, 0x00, 0x03, 0xF0, 0x00, 0x00, 0x00, 0x00, 0x00, 0x00, 0x00, 0x00, 0x00, 0x00, 0x00, 0x00, 0x00, 0x00, 0x3F, 0xFF, 0x00, 0x00, 0x00, 0x00, 0x00, 0x00, 0x00, 
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    0x00, 0x00, 0x00, 0x00, 0x00, 0x00, 0x00, 0x00, 0x00, 0x00, 0x00, 0x00, 0x00, 0x00, 0x00, 0x00, 0x00, 0x00, 0x00, 0x00, 0x00, 0x00, 0x00, 0x00, 0x00, 0x00, 0x00, 0x00, 0x00, 0x00, 0x00, 0x00};

/*Button and buzzer constants - Configured for a Seeeduino Xiao (SAMD21 board)
These will need to be changed if using a different microcontroller or button layout*/
int MicroGame::btnLUp = 10;    //left up
int MicroGame::btnLDn = 7;     //left down
int MicroGame::btnLLt = 8;     //left left
int MicroGame::btnLRt = 9;     //left right
int MicroGame::btnRUp = 3;     //right up
int MicroGame::btnRDn = 6;     //right down

//TODO 062825 - The breadboard version of this wont use these pins
int MicroGame::btnRLt = 2;     //right left
int MicroGame::btnRRt = 1;     //right right

int MicroGame::buzPin = 0;     //buzzer

/*Initialize all pins. This uses the internal pullup resistor of the Xiao so buttons are "pressed" when the value is LOW*/
void MicroGame::Begin(){
  pinMode(MicroGame::btnLUp, INPUT_PULLUP);
  pinMode(MicroGame::btnLDn, INPUT_PULLUP);
  pinMode(MicroGame::btnLLt, INPUT_PULLUP);
  pinMode(MicroGame::btnLRt, INPUT_PULLUP);
  pinMode(MicroGame::btnRUp, INPUT_PULLUP);
  pinMode(MicroGame::btnRDn, INPUT_PULLUP);
  pinMode(MicroGame::btnRLt, INPUT_PULLUP);
  pinMode(MicroGame::btnRRt, INPUT_PULLUP);  
  pinMode(MicroGame::buzPin, OUTPUT);
}


void MicroGame::Beep(int note, int duration)
{
  //Play tone on buzzerPin
  tone(MicroGame::buzPin, note, duration);
  delay(duration);
  noTone(MicroGame::buzPin);
  delay(50);
}

void MicroGame::RenderSplashScreen(){
    MicroGame::display.begin(SSD1306_SWITCHCAPVCC, 0x3C);
    MicroGame::display.clearDisplay();
    MicroGame::display.drawBitmap(0, 0, MicroGame::splashScreen, 128, 64, WHITE);
    MicroGame::display.setCursor(0,0);
    MicroGame::display.setTextSize(1);
    MicroGame::display.setTextColor(WHITE);
    MicroGame::display.println(versionNum);
    MicroGame::display.display();
    MicroGame::Beep(100, 150);
    MicroGame::Beep(200, 150);
    MicroGame::Beep(300, 150);
    MicroGame::Beep(400, 150);
    MicroGame::Beep(500, 150);
    MicroGame::Beep(600, 150);
    MicroGame::Beep(700, 500);
    delay(2000);
}

/*Control functions for when a button is pressed
in-scetch example: if(microGame.PressLUp()){*code here*}*/

/*Press Left Up*/
bool MicroGame::PressLUp(){
    if(digitalRead(MicroGame::btnLUp) == 0){return true;}
    else{return false;}
}
/*Press Left Down*/
bool MicroGame::PressLDn(){
    if(digitalRead(MicroGame::btnLDn) == 0){return true;}
    else{return false;}
}
/*Press Left Left*/
bool MicroGame::PressLLt(){
    if(digitalRead(MicroGame::btnLLt) == 0){return true;}
    else{return false;}
}
/*Press Left Right*/
bool MicroGame::PressLRt(){
    if(digitalRead(MicroGame::btnLRt) == 0){return true;}
    else{return false;}
}
/*Press Right Up*/
bool MicroGame::PressRUp(){
    if(digitalRead(MicroGame::btnRUp) == 0){return true;}
    else{return false;}
}
/*Press Right Down*/
bool MicroGame::PressRDn(){
    if(digitalRead(MicroGame::btnRDn) == 0){return true;}
    else{return false;}
}
/*Press Right Left*/
bool MicroGame::PressRLt(){
    if(digitalRead(MicroGame::btnRLt) == 0){return true;}
    else{return false;}
}
/*Press Right Right*/
bool MicroGame::PressRRt(){
    if(digitalRead(MicroGame::btnRRt) == 0){return true;}
    else{return false;}
}

